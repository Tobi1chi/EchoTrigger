## Hardware/Mic-ESP32/Kconfig.projbuild
```kconfig
menu "Mic ESP32 Configuration"

config MIC_SETUP_BUTTON_GPIO
    int "GPIO for forced setup button"
    range 0 48
    default 9
    help
        GPIO used for the forced setup long-press input.
        This must be a non-strapping input on your board.
        Do not use GPIO0 on ESP32-S3 boards because it is commonly
        tied to the BOOT button and affects ROM download mode.

endmenu
```

## Hardware/Mic-ESP32/sdkconfig.defaults
```kconfig
CONFIG_ESP32S3_DEFAULT_CPU_FREQ_240=y
CONFIG_FREERTOS_HZ=1000
CONFIG_ESP_MAIN_TASK_STACK_SIZE=8192
CONFIG_LWIP_MAX_SOCKETS=8
CONFIG_MQTT_PROTOCOL_311=y
CONFIG_ESPTOOLPY_FLASHSIZE_16MB=y
CONFIG_ESPTOOLPY_FLASHSIZE="16MB"
CONFIG_PARTITION_TABLE_CUSTOM=y
CONFIG_PARTITION_TABLE_CUSTOM_FILENAME="partitions.csv"
CONFIG_MIC_I2S_BCLK_GPIO=4
CONFIG_MIC_I2S_WS_GPIO=5
CONFIG_MIC_I2S_DIN_GPIO=6
CONFIG_MIC_SETUP_BUTTON_GPIO=9
CONFIG_MIC_STREAMING_ENABLED_DEFAULT=y
CONFIG_MIC_TELEMETRY_INTERVAL_MS=10000
CONFIG_MIC_SETUP_PORTAL_RETRY_DELAY_MS=2000
CONFIG_MIC_SETUP_BUTTON_HOLD_MS=5000
CONFIG_MIC_AUDIO_PACKET_QUEUE_DEPTH=16
```
